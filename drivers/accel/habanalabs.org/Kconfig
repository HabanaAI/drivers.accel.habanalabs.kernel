## drivers/accel/habanalabs.org/Kconfig
```kconfig
# SPDX-License-Identifier: GPL-2.0-only
#
# HabanaLabs AI accelerators driver
#

config DRM_ACCEL_HABANALABS
	tristate "HabanaLabs AI accelerators"
	depends on DRM_ACCEL
	depends on X86_64
	depends on PCI && HAS_IOMEM
	select GENERIC_ALLOCATOR
	select HWMON
	select DMA_SHARED_BUFFER
	select CRC32
	select FW_LOADER
	select AUXILIARY_BUS
	help
	  Enables PCIe card driver for Habana's AI Processors (AIP) that are
	  designed to accelerate Deep Learning inference and training workloads.

	  The driver manages the PCIe devices and provides IOCTL interface for
	  the user to submit workloads to the devices.

	  The user-space interface is described in
	  include/uapi/drm/habanalabs_accel.h

	  If unsure, say N.

	  To compile this driver as a module, choose M here: the
	  module will be called habanalabs.

config HL_HLDIO
	bool "Enable HabanaLabs NVMe Direct I/O support"
	depends on DRM_ACCEL_HABANALABS
	depends on PCI_P2PDMA
	depends on ZONE_DEVICE
	default y
	help
	  Enables NVMe Direct I/O support for HabanaLabs AI accelerators.
	  This feature allows direct data transfer between NVMe SSDs and
	  device memory using peer-to-peer DMA, bypassing system memory.

	  Requires PCI peer-to-peer DMA support (PCI_P2PDMA) and zone device
	  support (ZONE_DEVICE).

	  If unsure, say Y.

config HL_ODP
	bool "Enable HabanaLabs On-Demand Paging support"
	depends on DRM_ACCEL_HABANALABS
	depends on MMU
	select HMM_MIRROR
	default y
	help
	  Enables On-Demand Paging (ODP) support for HabanaLabs AI accelerators.
	  This feature uses the kernel's Heterogeneous Memory Management (HMM)
	  subsystem to provide on-demand paging of device memory, allowing
	  transparent migration of pages between system and device memory.

	  Requires HMM_MIRROR support in the kernel.

	  If unsure, say Y.
```
